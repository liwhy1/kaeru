## board/oneplus/Kconfig
```kconfig
config ONEPLUS_OP6893
    bool "Support OnePlus Nord 2"
    default n
    help
      Say Y if you want to include support for OnePlus Nord 2
```

## configs/oneplus/op6893_defconfig
```kconfig
CONFIG_BOOTLOADER_BASE=0x48200000
CONFIG_BOOTLOADER_SIZE=0x12419C
CONFIG_DPRINTF_ADDRESS=0x4823CFA4
CONFIG_FASTBOOT_FAIL_ADDRESS=0x4822F30C
CONFIG_FASTBOOT_INFO_ADDRESS=0x4822F28C
CONFIG_FASTBOOT_OKAY_ADDRESS=0x4822F4D8
CONFIG_FASTBOOT_PUBLISH_ADDRESS=0x4822EF18
CONFIG_FASTBOOT_REGISTER_ADDRESS=0x4822EEDC
CONFIG_FREE_ADDRESS=0x4823D3D4
CONFIG_LK_LOG_STORE_ADDRESS=0x4824F48C
CONFIG_MALLOC_ADDRESS=0x4823DCA0
CONFIG_MTK_DETECT_KEY_ADDRESS=0x48205728
CONFIG_PARTITION_READ_ADDRESS=0x482576B4
CONFIG_PLATFORM_INIT_ADDRESS=0x48203708
CONFIG_THREAD_CREATE_ADDRESS=0x4822ABEC
CONFIG_THREAD_RESUME_ADDRESS=0x4822AE00
CONFIG_VIDEO_PRINTF_ADDRESS=0x4823CCB4
CONFIG_BOOTMODE_ADDRESS=0x48327620
CONFIG_APP_ADDRESS=0x4822E7B8
CONFIG_PLATFORM_INIT_CALLER=0x4822A430
CONFIG_INIT_STORAGE_CALLER=0x4820373E
CONFIG_INIT_STORAGE_ADDRESS=0x4820356C
CONFIG_PARTITION_GET_SIZE_BY_NAME_ADDRESS=0x4825654C
CONFIG_CERT_BYPASS=y
CONFIG_CERT_BYPASS_MODE="wrap"
CONFIG_ONEPLUS_OP6893=y
CONFIG_MEDIATEK_MT6893=y
```
